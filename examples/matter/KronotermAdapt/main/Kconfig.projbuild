## examples/matter/KronotermAdapt/main/Kconfig.projbuild
```kconfig
menu "Application Configuration"

config MODBUS_BAUD_RATE
    int "Modbus RTU baud rate"
    default 115200
    help
        Baud rate of the RS-485 link to the heat pump. Must match the
        Modbus baud rate configured on the Kronoterm controller.

config MODBUS_SLAVE_ADDRESS
    int "Modbus slave address"
    range 1 247
    default 20
    help
        Modbus address of the Kronoterm heat pump controller.

endmenu
```

## examples/matter/SolaxX1G4/main/Kconfig.projbuild
```kconfig
menu "Application Configuration"

config MODBUS_BAUD_RATE
    int "Modbus RTU baud rate"
    default 9600
    help
        Baud rate of the RS-485 link to the inverter. Must match the
        Modbus baud rate configured on the Solax inverter.

config MODBUS_SLAVE_ADDRESS
    int "Modbus slave address"
    range 1 247
    default 1
    help
        Modbus address of the Solax inverter.

endmenu
```
